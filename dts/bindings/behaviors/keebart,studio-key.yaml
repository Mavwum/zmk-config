## dts/bindings/behaviors/keebart,studio-key.yaml
```yaml
description: Keebart runtime key binding
compatible: "keebart,studio-key"
include: two_param.yaml

properties:
  "#sensor-binding-cells":
    type: int
    const: 2
sensor-binding-cells:
  - param1
  - param2
```

## dts/bindings/behaviors/zmk,behavior-vault-boy-animation.yaml
```yaml
description: Sends WPM updates to the Vault Boy animation on a split peripheral

compatible: "zmk,behavior-vault-boy-animation"

include: one_param.yaml
```

## studio/Kconfig
```kconfig
config KEEBART_STUDIO
    bool "Keebart Studio USB configuration"
    depends on ZMK_USB && (!ZMK_SPLIT || ZMK_SPLIT_ROLE_CENTRAL)
    depends on !ZMK_STUDIO
    select SETTINGS
    select USB_DEVICE_HID

config KEEBART_STUDIO_PERIPHERAL
    bool "Keebart Studio split lighting receiver"
    depends on ZMK_SPLIT && !ZMK_SPLIT_ROLE_CENTRAL
```
